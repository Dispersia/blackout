## application/sysbuild/mcuboot/boards/nrf54lm20dk_nrf54lm20a_cpuapp_internal.conf
```kconfig
CONFIG_HW_STACK_PROTECTION=n
CONFIG_BOOT_WATCHDOG_FEED=n

CONFIG_ASSERT_VERBOSE=n
CONFIG_ASSERT_NO_FILE_INFO=y
CONFIG_PRINTK=n

CONFIG_SPI_NOR=n
CONFIG_SPI=n

CONFIG_BOOT_MAX_IMG_SECTORS=512

CONFIG_TICKLESS_KERNEL=y
```
